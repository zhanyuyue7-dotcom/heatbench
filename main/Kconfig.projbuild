## main/Kconfig.projbuild
```kconfig
menu "HeatBench configuration"

    menu "GPIO assignment"
        config HEATER_MAX6675_SCK_GPIO
            int "MAX6675 SCK GPIO"
            default 12
            range 0 48

        config HEATER_MAX6675_CS_GPIO
            int "MAX6675 CS GPIO"
            default 10
            range 0 48

        config HEATER_MAX6675_SO_GPIO
            int "MAX6675 SO/MISO GPIO"
            default 13
            range 0 48

        config HEATER_SSR_GPIO
            int "SSR driver GPIO"
            default 4
            range 0 48

        config HEATER_RGB_GPIO
            int "WS2812 data GPIO"
            default 48
            range 0 48

        config HEATER_RGB_LED_COUNT
            int "Number of WS2812 LEDs"
            default 7
            range 1 64
    endmenu

    config HEATER_SSR_ACTIVE_HIGH
        bool "SSR input is active-high"
        default y

    menu "Safety limits"
        config HEATER_MAX_TEMPERATURE_C
            int "Software over-temperature limit (degrees C)"
            default 270
            range 200 300

        config HEATER_RESIDUAL_WARNING_C
            int "Residual-heat warning threshold (degrees C)"
            default 50
            range 35 100

    endmenu

    menu "Wi-Fi"
        config HEATER_AP_PASSWORD
            string "Local access-point password"
            default "heater1234"
            help
                Must contain at least 8 characters. The device always exposes a
                HeatBench-XXXX access point at 192.168.4.1.

        config HEATER_STA_SSID
            string "Optional station SSID"
            default ""

        config HEATER_STA_PASSWORD
            string "Optional station password"
            default ""
    endmenu

endmenu
```
